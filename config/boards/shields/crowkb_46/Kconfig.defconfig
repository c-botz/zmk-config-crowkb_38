## config/boards/shields/crowkb_46/Kconfig.defconfig
```kconfig
if SHIELD_CROWKB_38_LEFT

config ZMK_KEYBOARD_NAME
    default "crowkb_38"

config ZMK_SPLIT_ROLE_CENTRAL
    default y

endif

if SHIELD_CROWKB_38_LEFT || SHIELD_CROWKB_38_RIGHT

config ZMK_SPLIT
    default y

endif
```

## config/boards/shields/crowkb_46/Kconfig.shield
```kconfig
config SHIELD_CROWKB_38_LEFT
    def_bool $(shields_list_contains,crowkb_38_left)

config SHIELD_CROWKB_38_RIGHT
    def_bool $(shields_list_contains,crowkb_38_right)
```
